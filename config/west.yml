## config/west.yml
```yaml
manifest:
  remotes:
    - name: zmkfirmware
      url-base: https://github.com/jashort
  projects:
    - name: zmk
      remote: zmk
      revision: main
      import: app/west.yml
  self:
    path: config
```
